## meta-chickeninvaders/conf/layer.conf
```bitbake
# We have a conf and classes directory, add to BBPATH
BBPATH .= ":${LAYERDIR}"

# We have recipes-* directories, add to BBFILES
BBFILES += "${LAYERDIR}/recipes-*/*/*.bb \
            ${LAYERDIR}/recipes-*/*/*.bbappend"

BBFILE_COLLECTIONS += "meta-chickeninvaders"
BBFILE_PATTERN_meta-chickeninvaders = "^${LAYERDIR}/"
BBFILE_PRIORITY_meta-chickeninvaders = "6"

LAYERDEPENDS_meta-chickeninvaders = "core"
LAYERSERIES_COMPAT_meta-chickeninvaders = "kirkstone"
```

## meta-minecraft/conf/layer.conf
```bitbake
# File: meta-minecraft/conf/layer.conf
BBPATH .= ":${LAYERDIR}"
BBFILES += "${LAYERDIR}/recipes-*/*/*.bb ${LAYERDIR}/recipes-*/*/*.bbappend"
BBFILE_COLLECTIONS += "meta-minecraft"
BBFILE_PATTERN_meta-minecraft = "^${LAYERDIR}/"
BBFILE_PRIORITY_meta-minecraft = "10"
LAYERSERIES_COMPAT_meta-minecraft = "kirkstone"
```

## meta-supertux/conf/layer.conf
```bitbake
# We have a conf and classes directory, add to BBPATH
BBPATH .= ":${LAYERDIR}"

# We have recipes-* directories, add to BBFILES
BBFILES += "${LAYERDIR}/recipes-*/*/*.bb \
            ${LAYERDIR}/recipes-*/*/*.bbappend"

BBFILE_COLLECTIONS += "meta-supertux"
BBFILE_PATTERN_meta-supertux = "^${LAYERDIR}/"
BBFILE_PRIORITY_meta-supertux = "6"

LAYERDEPENDS_meta-supertux = "core"
LAYERSERIES_COMPAT_meta-supertux = "kirkstone"
```
